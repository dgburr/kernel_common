## arch/arm/mach-meson3/Kconfig.boards
```kconfig
if ARCH_MESON3

config MACH_M3_SKT
	depends on ARCH_MESON3=y
	bool "Meson3 socket board"
	default y
	select I2C_AML
	select AML_HDMI_TX
	select FB_AM
	select FB_OSD2_CURSOR
	select SND_AML_M3
	select USB_DWC_OTG_HCD
	help
	  Support for Amlogic Meson3 socket board.

config MACH_M3_REF
	depends on ARCH_MESON3=y
	bool "Meson3 reference board"
	default y
	help
	  Support for Amlogic Meson3 reference development platform.

config MACH_MESON3_STV_MBX_MC
	select GENERIC_ALLOCATOR
	bool "Support M3 (geniatech) platform"
	help
	  Include support for the AML M3 geniatech board platform.


endif # ARCH_MESON3
```
